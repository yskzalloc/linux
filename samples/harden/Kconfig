## samples/harden/Kconfig
```kconfig
# SPDX-License-Identifier: GPL-2.0-only
config SAMPLE_HARDEN
	tristate "Buggy KCOV/KASAN hardening demo drivers"
	depends on KCOV && m
	help
	  Build three deliberately buggy misc-device drivers used by the
	  "KCOV + libFuzzer/FuzzTest + KASAN" hands-on hardening tutorial:

	    harden_local  - parses a zero-copy shared page in syscall context
	                    (local KCOV coverage).
	    harden_remote - parses the same page on a workqueue kthread
	                    (remote KCOV coverage, KCOV_REMOTE_ENABLE).

	    harden_ledger - a per-file memory quota whose accounting drifts
	                    after ALLOC/RESIZE/FREE (a logic bug KASAN cannot
	                    see; found by a FuzzTest model-based property).

	  The first two contain a write-side out-of-bounds bug behind an
	  under-covered branch, intended to be found by the userspace libFuzzer
	  harnesses in tools/harden/sample/ or the FuzzTest harnesses in
	  tools/harden/fuzztest/. Do NOT enable on a production kernel.

	  If unsure, say N.
```

## samples/rust/Kconfig
```kconfig
# SPDX-License-Identifier: GPL-2.0

menuconfig SAMPLES_RUST
	bool "Rust samples"
	depends on RUST
	help
	  You can build sample Rust kernel code here.

	  If unsure, say N.

if SAMPLES_RUST

config SAMPLE_RUST_CONFIGFS
	tristate "Configfs sample"
	depends on CONFIGFS_FS
	help
	  This option builds the Rust configfs sample.

	  To compile this as a module, choose M here:
	  the module will be called rust_configfs.

	  If unsure, say N.

config SAMPLE_RUST_MINIMAL
	tristate "Minimal"
	help
	  This option builds the Rust minimal module sample.

	  To compile this as a module, choose M here:
	  the module will be called rust_minimal.

	  If unsure, say N.

config SAMPLE_RUST_MISC_DEVICE
	tristate "Misc device"
	help
	  This option builds the Rust misc device.

	  To compile this as a module, choose M here:
	  the module will be called rust_misc_device.

	  If unsure, say N.

config SAMPLE_RUST_PRINT
	tristate "Printing macros"
	help
	  This option builds the Rust printing macros sample.

	  To compile this as a module, choose M here:
	  the module will be called rust_print.

	  If unsure, say N.

config SAMPLE_RUST_DMA
	tristate "DMA Test Driver"
	depends on PCI
	help
	  This option builds the Rust DMA Test driver sample.

	  To compile this as a module, choose M here:
	  the module will be called rust_dma.

	  If unsure, say N.

config SAMPLE_RUST_DEBUGFS
	tristate "DebugFS Test Module"
	depends on DEBUG_FS
	help
	  This option builds the Rust DebugFS Test module sample.

	  To compile this as a module, choose M here:
	  the module will be called rust_debugfs.

	  If unsure, say N.

config SAMPLE_RUST_DEBUGFS_SCOPED
	tristate "Scoped DebugFS Test Module"
	depends on DEBUG_FS
	help
	  This option builds the Rust Scoped DebugFS Test module sample.

	  To compile this as a module, choose M here:
	  the module will be called rust_debugfs_scoped.

	  If unsure, say N.

config SAMPLE_RUST_DRIVER_I2C
	tristate "I2C Driver"
	depends on I2C=y
	help
	  This option builds the Rust I2C driver sample.

	  To compile this as a module, choose M here:
	  the module will be called rust_driver_i2c.

	  If unsure, say N.

config SAMPLE_RUST_I2C_CLIENT
	tristate "I2C Client Registration"
	depends on I2C=y
	help
	  This option builds the Rust I2C client manual creation
	  sample.

	  To compile this as a module, choose M here:
	  the module will be called rust_i2c_client.

	  If unsure, say N.

config SAMPLE_RUST_DRIVER_PCI
	tristate "PCI Driver"
	depends on PCI
	help
	  This option builds the Rust PCI driver sample.

	  To compile this as a module, choose M here:
	  the module will be called rust_driver_pci.

	  If unsure, say N.

config SAMPLE_RUST_DRIVER_PLATFORM
	tristate "Platform Driver"
	help
	  This option builds the Rust Platform driver sample.

	  To compile this as a module, choose M here:
	  the module will be called rust_driver_platform.

	  If unsure, say N.

config SAMPLE_RUST_DRIVER_USB
	tristate "USB Driver"
	depends on USB = y
	help
	  This option builds the Rust USB driver sample.

	  To compile this as a module, choose M here:
	  the module will be called rust_driver_usb.

	  If unsure, say N.

config SAMPLE_RUST_DRIVER_FAUX
	tristate "Faux Driver"
	help
	  This option builds the Rust Faux driver sample.

	  To compile this as a module, choose M here:
	  the module will be called rust_driver_faux.

	  If unsure, say N.

config SAMPLE_RUST_DRIVER_AUXILIARY
	tristate "Auxiliary Driver"
	depends on PCI
	select AUXILIARY_BUS
	help
	  This option builds the Rust auxiliary driver sample.

	  To compile this as a module, choose M here:
	  the module will be called rust_driver_auxiliary.

	  If unsure, say N.

config SAMPLE_RUST_DRIVER_SERDEV
	tristate "Serial Device Bus Device Driver"
	select RUST_SERIAL_DEV_BUS_ABSTRACTIONS
	help
	  This option builds the Rust serial device bus driver sample.

	  To compile this as a module, choose M here:
	  the module will be called rust_driver_serdev.

	  If unsure, say N.

config SAMPLE_RUST_SOC
	tristate "SoC Driver"
	select SOC_BUS
	help
	  This option builds the Rust SoC driver sample.

	  To compile this as a module, choose M here:
	  the module will be called rust_soc.

	  If unsure, say N.

config SAMPLE_RUST_HOSTPROGS
	bool "Host programs"
	help
	  This option builds the Rust host program samples.

	  If unsure, say N.

config SAMPLE_RUST_HARDEN
	tristate "Hardening demo driver (local KCOV coverage)"
	depends on KCOV && m
	help
	  Build the Rust buggy-on-purpose misc device used by the
	  "KCOV + libFuzzer + KASAN" hardening tutorial (local coverage).
	  It co-maps a page with userspace and parses it with a write-side
	  out-of-bounds bug behind an under-covered branch. Do NOT enable on
	  a production kernel.

	  If unsure, say N.

config SAMPLE_RUST_HARDEN_REMOTE
	tristate "Hardening demo driver (remote KCOV coverage)"
	depends on SAMPLE_RUST_HARDEN
	default SAMPLE_RUST_HARDEN
	help
	  Build the remote-coverage (workqueue + KCOV_REMOTE_ENABLE) Rust
	  variant. It uses the KCOV remote FFI (kcov_remote_start/stop,
	  kcov_common_handle), which rust/bindings/bindings_helper.h now exposes
	  by including <linux/kcov.h>. Defaults to the same value as
	  SAMPLE_RUST_HARDEN so it is built alongside the local Rust driver.

	  If unsure, say N.

endif # SAMPLES_RUST
```
